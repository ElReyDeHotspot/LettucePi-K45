## scripts/k45p.its
```
/dts-v1/;
/ {
    description = "LettucePi K45P FIT";
    #address-cells = <1>;
    images {
        kernel-1 {
            description = "ARM64 OpenWrt Linux-6.12.94";
            data = /incbin/("kernel.bin");
            type = "kernel"; arch = "arm64"; os = "linux";
            compression = "gzip"; load = <0x46000000>; entry = <0x46000000>;
            hash-1 { algo = "crc32"; }; hash-2 { algo = "sha1"; };
        };
        fdt-1 {
            description = "ARM64 OpenWrt misectel_m02k45 device tree blob";
            data = /incbin/("k45p.dtb");
            type = "flat_dt"; arch = "arm64"; compression = "none";
            load = <0x45f00000>;
            hash-1 { algo = "crc32"; }; hash-2 { algo = "sha1"; };
        };
        rootfs-1 {
            description = "LettucePi K45P rootfs";
            data = /incbin/("rootfs.squashfs");
            type = "filesystem"; arch = "arm64"; compression = "none";
            hash-1 { algo = "crc32"; }; hash-2 { algo = "sha1"; };
        };
    };
    configurations {
        default = "config-1";
        config-1 {
            description = "OpenWrt misectel_m02k45";
            kernel = "kernel-1"; fdt = "fdt-1"; loadables = "rootfs-1";
        };
    };
};
```
